                                                                          
/*==========================================================================*/
/*                              LIGHTSENSOR.C                               */
/*                                                                          */
/*==========================================================================*/
/*Author    : ZHUHUA                                                        */
/*Project   :                                                               */
/*Compile   :                                                               */
/*Processor :                                                               */
/*Customer  :                                                               */
/*Created   : 2015-06-10                                                    */
/*--------------------------------------------------------------------------*/
/*Description :                                                             */
/*                                                                          */
/*                                                                          */
/*==========================================================================*/
/*Modification History :                                                    */
/*                                                                          */
/*                                                                          */
/*==========================================================================*/
                                                                          
#define SDA 7
#define SCL 4
#define SlaveAddress 0x46
#define dHigh  1     
#define dLow   0                                                                     
                                                                          
/*==========================================================================*/
/*                                 includes                                 */
/*==========================================================================*/
#include"wiringPi.h"
#include"stdio.h"


                                                                          
/*==========================================================================*/
/*                  Const variable definitions (const...)                   */
/*==========================================================================*/
                                                                          
                                                                          
/*==========================================================================*/
/*                      Type definitions (typedef...)                       */
/*==========================================================================*/
 typedef unsigned char		   TBit;							/*	1 Bit */
//#endif
 
 typedef unsigned char		   TByte;							/*	8 Bit */
 typedef signed char		   TVByte;							/*	8 Bit */
 
 typedef unsigned char		   uchar;							/*	8 Bit */
 
 typedef unsigned int		   TWord;							/* 16 Bit */
 typedef signed int 		   TVWord;							/* 16 Bit */
 
 typedef unsigned long		   TLong;							/* 32 Bit */
 typedef signed long		   TVLong;							/* 32 Bit */
 
 typedef char				   TChar;							/* (ASCII-) 
 Code */
 typedef unsigned char		   TBool;							/* Boolean */
 
 typedef float				   TFSingle;						/* float type */                                                                         
                                                                          
/*==========================================================================*/
/*                       Public variable definitions                        */
/*==========================================================================*/
 TWord  LightMeasureValue; 
 TWord  LightValue;
 TByte  lightsensorbuf[3];
/*==========================================================================*/
/*                  Private variable definitions (static)                   */
/*==========================================================================*/
                                                                          
                                                                          
/*==========================================================================*/
/*                    Function declarations (prototypes)                    */
/*==========================================================================*/
                                                                        
                                                                          
/*==========================================================================*/
/*                        Function definition Start                         */
/*==========================================================================*/
                                                                          
/*==========================================================================*/
/*                               bh1750_start()                             */
/*                                                                          */
/*==========================================================================*/
/*Author    : ZHUHUA                                                        */
/*Project   :                                                               */
/*Access    : public                                                        */
/*Created   : 2015-06-27                                                    */
/*--------------------------------------------------------------------------*/
/*Input     : ----                                                          */
/*Output    : ----                                                          */
/*Changed   : ----                                                          */
/*--------------------------------------------------------------------------*/
/*Description :                                                             */
/*                                                                          */
/*                                                                          */
/*==========================================================================*/
void bh1750_start( void )
{
    pinMode(SDA,OUTPUT);
    pinMode(SCL,OUTPUT);
    pullUpDnControl(SCL,PUD_UP);
    delayMicroseconds(5); 
    digitalWrite(SDA,dHigh);                    //À­¸ßÊý¾ÝÏß
    digitalWrite(SCL,dHigh);                     //À­¸ßÊ±ÖÓÏß
    delayMicroseconds(5);                 //ÑÓÊ±
    digitalWrite(SDA,dLow);                     //²úÉúÏÂ½µÑØ
    delayMicroseconds(5);                 //ÑÓÊ±
    digitalWrite(SCL,dLow);                    //À­µÍÊ                                                                      
                                                                          
//return();
}
/*==========================================================================*/
/*End of Function bh1750_start()                                            */
                                                                       
                                                                          
/*==========================================================================*/
/*                               bh1750_stop()                              */
/*                                                                          */
/*==========================================================================*/
/*Author    : ZHUHUA                                                        */
/*Project   :                                                               */
/*Access    : public                                                        */
/*Created   : 2015-06-27                                                    */
/*--------------------------------------------------------------------------*/
/*Input     : ----                                                          */
/*Output    : ----                                                          */
/*Changed   : ----                                                          */
/*--------------------------------------------------------------------------*/
/*Description :                                                             */
/*                                                                          */
/*                                                                          */
/*==========================================================================*/
void bh1750_stop( void )
{   
    pinMode(SDA,OUTPUT);
    pinMode(SCL,OUTPUT);
    digitalWrite(SDA,dLow);                   //À­µÍÊý¾ÝÏß
    digitalWrite(SCL,dHigh);                     //À­¸ßÊ±ÖÓÏß
    delayMicroseconds(5);                 //ÑÓÊ±
    digitalWrite(SDA,dHigh);              //²úÉúÉÏÉýÑØ
    delayMicroseconds(5);                 //ÑÓÊ±                                                                          
                                                                          
//return();
}
/*==========================================================================*/
/*End of Function bh1750_stop()                                             */

                                                                          
/*==========================================================================*/
/*                              bh1750send_ack()                            */
/*                                                                          */
/*==========================================================================*/
/*Author    : ZHUHUA                                                        */
/*Project   :                                                               */
/*Access    : public                                                        */
/*Created   : 2015-06-27                                                    */
/*--------------------------------------------------------------------------*/
/*Input     : ----                                                          */
/*Output    : ----                                                          */
/*Changed   : ----                                                          */
/*--------------------------------------------------------------------------*/
/*Description :                                                             */
/*                                                                          */
/*                                                                          */
/*==========================================================================*/
void bh1750send_ack( TBit ack)
{   
    pinMode(SDA,OUTPUT);
    pinMode(SCL,OUTPUT);
    digitalWrite(SDA,ack);                  //Ð´Ó¦´ðÐÅºÅ
    digitalWrite(SCL,dHigh);               //À­¸ßÊ±ÖÓÏß
    delayMicroseconds(5);                 //ÑÓÊ±
    digitalWrite(SCL,dLow);               //À­µÍÊ±ÖÓÏß
    delayMicroseconds(5);                 //ÑÓÊ±                                                                          
                                                                          
//return();
}
/*==========================================================================*/
/*End of Function bh1750send_ack()                                          */


                                                                          
/*==========================================================================*/
/*                              bh1750rec_ack()                             */
/*                                                                          */
/*==========================================================================*/
/*Author    : ZHUHUA                                                        */
/*Project   :                                                               */
/*Access    : public                                                        */
/*Created   : 2015-06-27                                                    */
/*--------------------------------------------------------------------------*/
/*Input     : ----                                                          */
/*Output    : ----                                                          */
/*Changed   : ----                                                          */
/*--------------------------------------------------------------------------*/
/*Description :                                                             */
/*                                                                          */
/*                                                                          */
/*==========================================================================*/
TBit bh1750rec_ack( void )
{   
    pinMode(SDA,INPUT);
    pinMode(SCL,OUTPUT);
    TBit num1;
    digitalWrite(SCL,dHigh);                     //À­¸ßÊ±ÖÓÏß
    delayMicroseconds(5);                //ÑÓÊ±
    num1 = digitalRead(SDA);                               //¶ÁÓ¦´ðÐÅºÅ
    digitalWrite(SCL,dLow);                     //À­µÍÊ±ÖÓÏß
    delayMicroseconds(5);                 //ÑÓÊ±
    return num1;
}                                                                         
                                                                          

/*==========================================================================*/
/*End of Function bh1750rec_ack()                                           */

                                                                          
/*==========================================================================*/
/*                              bh1750sendbyte()                            */
/*                                                                          */
/*==========================================================================*/
/*Author    : ZHUHUA                                                        */
/*Project   :                                                               */
/*Access    : public                                                        */
/*Created   : 2015-06-27                                                    */
/*--------------------------------------------------------------------------*/
/*Input     : ----                                                          */
/*Output    : ----                                                          */
/*Changed   : ----                                                          */
/*--------------------------------------------------------------------------*/
/*Description :                                                             */
/*                                                                          */
/*                                                                          */
/*==========================================================================*/
void bh1750send_byte( TByte dat )
{
    TByte i;
    pinMode(SDA,OUTPUT);
    pinMode(SCL,OUTPUT);
    for (i=0; i<8; i++)         //8Î»¼ÆÊýÆ÷
    {
        if((dat&0x80) == 0x80)
        {
            digitalWrite(SDA,dHigh);
        }
		else
		{
			digitalWrite(SDA,dLow);
		}
        dat <<= 1;              //ÒÆ³öÊý¾ÝµÄ×î¸ßÎ»
        digitalWrite(SCL,dHigh);                //À­¸ßÊ±ÖÓÏß
        delayMicroseconds(5);             //ÑÓÊ±
        digitalWrite(SCL,dLow);               //À­µÍÊ±ÖÓÏß
        delayMicroseconds(5);             //ÑÓÊ±
    }
    bh1750rec_ack();
                                                                          
//return();
}
/*==========================================================================*/
/*End of Function bh1750sendbyte()                                          */
                                                                         
                                                                          
/*==========================================================================*/
/*                              bh1750rec_byte()                             */
/*                                                                          */
/*==========================================================================*/
/*Author    : ZHUHUA                                                        */
/*Project   :                                                               */
/*Access    : public                                                        */
/*Created   : 2015-06-27                                                    */
/*--------------------------------------------------------------------------*/
/*Input     : ----                                                          */
/*Output    : ----                                                          */
/*Changed   : ----                                                          */
/*--------------------------------------------------------------------------*/
/*Description :                                                             */
/*                                                                          */
/*                                                                          */
/*==========================================================================*/
TByte bh1750rec_byte( void )
{
    TByte i;
    TByte dat = 0;
    pinMode(SDA,INPUT);
    pinMode(SCL,OUTPUT);    
    for (i=0; i<8; i++)         //8Î»¼ÆÊýÆ÷
    {
        dat <<= 1;
        digitalWrite(SCL,dHigh);                 //À­¸ßÊ±ÖÓÏß
        delayMicroseconds(5);             //ÑÓÊ±
        dat = dat | digitalRead(SDA);             //¶ÁÊý¾Ý               
        digitalWrite(SCL,dLow);                //À­µÍÊ±ÖÓÏß
        delayMicroseconds(5);             //ÑÓÊ±
    }
    return dat;
}                                                                         
                                                                          
/*==========================================================================*/
/*End of Function bh1750rec_byte()                                           */

                                                                          
/*==========================================================================*/
/*                            send_single_bh1750()                          */
/*                                                                          */
/*==========================================================================*/
/*Author    : ZHUHUA                                                        */
/*Project   :                                                               */
/*Access    : public                                                        */
/*Created   : 2015-06-27                                                    */
/*--------------------------------------------------------------------------*/
/*Input     : ----                                                          */
/*Output    : ----                                                          */
/*Changed   : ----                                                          */
/*--------------------------------------------------------------------------*/
/*Description :                                                             */
/*                                                                          */
/*                                                                          */
/*==========================================================================*/
void send_single_tobh1750( TByte command)
{
    bh1750_start();                  //ÆðÊ¼ÐÅºÅ
    bh1750send_byte(SlaveAddress);   //·¢ËÍÉè±¸µØÖ·+Ð´ÐÅºÅ
    bh1750send_byte(command);        //ÄÚ²¿¼Ä´æÆ÷µØÖ·£¬
    bh1750_stop();                   //·¢ËÍÍ£Ö¹ÐÅºÅ                                                                          
                                                                          
//return();
}
/*==========================================================================*/
/*End of Function send_single_bh1750()                                      */

                                                                          
                                                                          
/*==========================================================================*/
/*                        rec_wordsingle_frombh1750()                       */
/*                                                                          */
/*==========================================================================*/
/*Author    : ZHUHUA                                                        */
/*Project   :                                                               */
/*Access    : public                                                        */
/*Created   : 2015-06-27                                                    */
/*--------------------------------------------------------------------------*/
/*Input     : ----                                                          */
/*Output    : ----                                                          */
/*Changed   : ----                                                          */
/*--------------------------------------------------------------------------*/
/*Description :                                                             */
/*                                                                          */
/*                                                                          */
/*==========================================================================*/
TWord rec_wordsingle_frombh1750( void )
{
    TByte i;
    TWord data;	
    bh1750_start();                          //ÆðÊ¼ÐÅºÅ
    bh1750send_byte(SlaveAddress+1);         //·¢ËÍÉè±¸µØÖ·+¶ÁÐÅºÅ
    for (i=0; i<2; i++)                      //Á¬Ðø¶ÁÈ¡2¸öµØÖ·Êý¾Ý£¬´æ´¢ÖÐBUF
    {
        lightsensorbuf[i] = bh1750rec_byte();          //BUF[0]´æ´¢0x32µØÖ·ÖÐµÄÊý¾Ý
        if (i == 3)
        {
	    bh1750send_ack(1);                //×îºóÒ»¸öÊý¾ÝÐèÒª»ØNOACK
        }
        else
        {		
            bh1750send_ack(0);                //»ØÓ¦ACK
        }
    }
    bh1750_stop(); 
    delay(5);   			   
    data = lightsensorbuf[0];
    data = (data<<8) + lightsensorbuf[1];                                                                                                                                                           
    return data;
}
/*==========================================================================*/
/*End of Function rec_wordsingle_frombh1750()                               */




                                                                          
                                                                          
/*==========================================================================*/
/*                              Bh1750ValueGet()                            */
/*                                                                          */
/*==========================================================================*/
/*Author    : ZHUHUA                                                        */
/*Project   :                                                               */
/*Access    : public                                                        */
/*Created   : 2015-06-16                                                    */
/*--------------------------------------------------------------------------*/
/*Input     : ----                                                          */
/*Output    : ----                                                          */
/*Changed   : ----                                                          */
/*--------------------------------------------------------------------------*/
/*Description :                                                             */
/*                                                                          */
/*                                                                          */
/*==========================================================================*/
TWord Bh1750ValueGet( void )
{   
    TWord filter1,filter2;

    send_single_tobh1750(0x01);
    send_single_tobh1750(0x10);
    delay(180);  
    filter1 = rec_wordsingle_frombh1750();
    send_single_tobh1750(0x00);
    
    send_single_tobh1750(0x01);
    send_single_tobh1750(0x10);
    delay(180);  
    filter2 = rec_wordsingle_frombh1750();
    send_single_tobh1750(0x00);

    if(  ( ( filter1-filter2 ) > 0x06 ) || ( ( filter2-filter1 ) > 0x06 )  )//data is not steady
    {
        ;
    }
    else
    {
        LightMeasureValue = filter2;
        LightValue = LightMeasureValue*6/5;
    }
    return LightValue;   
}

/*==========================================================================*/
/*End of Function Bh1750ValueGet()                                          */

                                                                          
/*==========================================================================*/











#include <wiringPi.h>
#include "stdio.h"     

/*==========================================================================*/
/*                               THSENSOR.C                               */
/*                                                                          */
/*==========================================================================*/
/*Author    : YIZHILAOLIHUA                                                 */
/*Project   :                                                               */
/*Compile   :                                                                      */
/*Processor :                                                                      */
/*Customer  :                                                                     */
/*Created   : 2015-06-08                                                    */
/*--------------------------------------------------------------------------*/
/*Description :   Sensor modle :am2302                                                        */
/*                                                                          */
/*                                                                          */
/*==========================================================================*/
/*Modification History :                                                    */
/*                                                                          */
/*                                                                          */
/*==========================================================================*/
                                                                          

                                                                          
                                                                          
/*==========================================================================*/
/*                                 includes                                 */
/*==========================================================================*/

#define TempHumSensorPin 3 
#define test 5      
#define dLow 0 
#define dHigh 1   
                                                                          
                                                                          
                                                                          
                                                                          
/*==========================================================================*/
/*                  Const variable definitions (const...)                   */
/*==========================================================================*/
                                                                          
                                                                          
/*==========================================================================*/
/*                      Type definitions (typedef...)                       */
/*==========================================================================*/
                                                                       
                                                                          
/*==========================================================================*/
/*                       Public variable definitions                        */
/*==========================================================================*/
  TWord TemperatureMultTen;
  TWord HumidityMultTen;
  TWord Humidity;
  TWord Temperature;
  TByte DateReceive[5]={0x00,0x00,0x00,0x00,0x00};//
  
/*==========================================================================*/
/*                  Private variable definitions (static)                   */
/*==========================================================================*/
                                                                          
                                                                          
/*==========================================================================*/
/*                    Function declarations (prototypes)                    */
/*==========================================================================*/
                                                                          
                                                                          
/*==========================================================================*/
/*                        Function definition Start                         */
/*==========================================================================*/
                                                                          
/*==========================================================================*/
/*                              Am2302readbyte()                            */
/*                                                                          */
/*==========================================================================*/
/*Author    :zhuhua                                                   */
/*Project   :                                                          */
/*Access    : public                                                        */
/*Created   : 2015-07-05                                                    */
/*--------------------------------------------------------------------------*/
/*Input     : ----                                                          */
/*Output    : ----                                                          */
/*Changed   : ----                                                          */
/*--------------------------------------------------------------------------*/
/*Description :                                                             */
/*                                                                          */
/*                                                                          */
/*==========================================================================*/
 TByte  Am2302readbyte()                                                  \
{   TByte num1,num2,num3;
    TByte data_receive;
    num2=0;
    num3=0;
        for(num1=0;num1<200;num1++)
	{	
		if(digitalRead(TempHumSensorPin) == 0)
		{
                        //digitalWrite(test,dLow);
		        if(num2>8)//data 1
			{	
				data_receive = data_receive<<1;
				data_receive = data_receive+1;
                                num3++;
                                num2=0;
                               // printf("%d.\n",1);
			}
			else if(num2 > 2)   
			{
				data_receive = data_receive<<1;
                                num3++;
                                num2=0;	
                               // printf("%d.\n",0);
			}
			
		}
		else if (digitalRead(TempHumSensorPin) == 1)
		{   
		        num2++;
                       // digitalWrite(test,dHigh);
		}
		delayMicroseconds(5);
                if(num3 > 7)
                {
                    num1=0;
                    break;
                }
	}
   // printf("%d.\n",num3);
  //  printf("%x.\n",data_receive);
    return data_receive;	
}
/*==========================================================================*/
/*End of Function Am2302readbyte()                                    */

                                                                          
/*==========================================================================*/
/*                               DateProcess()                              */
/*                                                                          */
/*==========================================================================*/
/*Author    : ZHUHUA                                                        */
/*Project   :                                                               */
/*Access    : public                                                        */
/*Created   : 2015-06-09                                                    */
/*--------------------------------------------------------------------------*/
/*Input     : ----                                                          */
/*Output    : ----                                                          */
/*Changed   : ----                                                          */
/*--------------------------------------------------------------------------*/
/*Description :                                                             */
/*                                                                          */
/*                                                                          */
/*==========================================================================*/
void DateProcess( void )
{   
    if(DateReceive[0]+DateReceive[1]+DateReceive[2]+DateReceive[3] == DateReceive[4])
     {  //printf("%x.\n",0x55);
		HumidityMultTen = (DateReceive[0]<<8) + DateReceive[1];
		Humidity = HumidityMultTen / 10 ;
		if((DateReceive[2]&0x80)==0x80)
		{
			TemperatureMultTen = ((DateReceive[2]&0x7f)<<8) + DateReceive[3];  
			Temperature = 0 - TemperatureMultTen / 10; 
		}
		else
		{
			TemperatureMultTen = (DateReceive[2]<<8) +  DateReceive[3];
			Temperature = TemperatureMultTen / 10;
		}
     }                                                                         
//return();
}
/*==========================================================================*/
/*End of Function DateProcess()                                             */
                                                               
                                                                          
/*==========================================================================*/
/*                              AM2302ValueGet()                            */
/*                                                                          */
/*==========================================================================*/
/*Author    : zhuhua                                                */
/*Project   :                                                           */
/*Access    : public                                                        */
/*Created   : 2015-06-08                                                    */
/*--------------------------------------------------------------------------*/
/*Input     : ----                                                          */
/*Output    : ----                                                          */
/*Changed   : ----                                                          */
/*--------------------------------------------------------------------------*/
/*Description : called in every 2s                                                           */
/*                                                                          */
/*                                                                          */
/*==========================================================================*/
void AM2302ValueGet( void )
{   
    pullUpDnControl(TempHumSensorPin,PUD_UP);
    pinMode(TempHumSensorPin,OUTPUT);
    pinMode(test,OUTPUT);
          
    digitalWrite(TempHumSensorPin,dLow);
    delay(1);  
    digitalWrite(TempHumSensorPin,dHigh);
    delayMicroseconds(20);
    pinMode(TempHumSensorPin,INPUT);
    delayMicroseconds(150);
    //wait the end of 1:data is beginning

	DateReceive[0] =Am2302readbyte();

	DateReceive[1] =Am2302readbyte();
      
	DateReceive[2] =Am2302readbyte();
        
	DateReceive[3] =Am2302readbyte();

	DateReceive[4] =Am2302readbyte();
        
	DateProcess();
	delay(2000); //am2302 rest  more than  2s every time
	/*

	*/
	
//return();
}
/*==========================================================================*/
/*End of Function AM2302ValueGet()                                          */
                                                                  
/*                             returnTemperature()                            */
/*                                                                          */
/*==========================================================================*/
/*Author    : ZHUHUA                                                        */
/*Project   :                                                               */
/*Access    : public                                                        */
/*Created   : 2015-06-16                                                    */
/*--------------------------------------------------------------------------*/
/*Input     : ----                                                          */
/*Output    : ----                                                          */
/*Changed   : ----                                                          */
/*--------------------------------------------------------------------------*/
/*Description :                                                             */
/*                                                                          */
/*                                                                          */
/*==========================================================================*/
TWord  returnTemperature() 
{   
    return Temperature;   
}

/*==========================================================================*/
/*End of Function returnTemperature()                                          */                                                                         
                                                                          


/*                             returnHumidity()                            */
/*                                                                          */
/*==========================================================================*/
/*Author    : ZHUHUA                                                        */
/*Project   :                                                               */
/*Access    : public                                                        */
/*Created   : 2015-06-16                                                    */
/*--------------------------------------------------------------------------*/
/*Input     : ----                                                          */
/*Output    : ----                                                          */
/*Changed   : ----                                                          */
/*--------------------------------------------------------------------------*/
/*Description :                                                             */
/*                                                                          */
/*                                                                          */
/*==========================================================================*/
TWord  returnHumidity() 
{   
    return Humidity;   
}

/*==========================================================================*/
/*End of Function returnHumidity()                                          */                                                                         
                                                                          

                                                                         
/*==========================================================================*/
/*End of module T&H SENSOR.C                                                */










                                                                        
/*==========================================================================*/
/*                               DUSTSENSOR.C                               */
/*                                                                          */
/*==========================================================================*/
/*Author    : ZHUHUA                                                        */
/*Project   :                                                               */
/*Compile   :                                                               */
/*Processor :                                                               */
/*Customer  :                                                               */
/*Created   : 2015-06-10                                                    */
/*--------------------------------------------------------------------------*/
/*Description :  dust sensor model:dsm501                                                           */
/*                                                                          */
/*                                                                          */
/*=========================================================================*/
/*Modification History :                                                    */
/*                                                                          */
/*                                                                          */
/*==========================================================================*/
                                                                          
#define __DUSTSENSOR_C 
                                                                          
                                                                          
/*==========================================================================*/
/*                                 includes                                 */
/*==========================================================================*/

#include"wiringPi.h"
#include"stdio.h"
#define DSM501Out1Pin  1
#define DSM501Out2Pin  2

                                                                          
                                                                          
                                                                          
/*==========================================================================*/
/*                  Const variable definitions (const...)                   */
/*==========================================================================*/
                                                                       
                                                                          
/*==========================================================================*/
/*                      Type definitions (typedef...)                       */
/*==========================================================================*/
                                                                          
                                                                          
/*==========================================================================*/
/*                       Public variable definitions                        */
/*==========================================================================*/
unsigned char DSM501ErrorFlag;
unsigned long DSM501LowTimeIn30s;
unsigned int DSM501LowRatio;
TWord DustConcentration1;
TWord DustConcentration2;
                                                                          
/*==========================================================================*/
/*                  Private variable definitions (static)                   */
/*==========================================================================*/
                                                                          
                                                                          
/*==========================================================================*/
/*                    Function declarations (prototypes)                    */
/*==========================================================================*/
                                                                          
                                                                          
/*==========================================================================*/
/*                        Function definition Start                         */
/*==========================================================================*/
                                                                          

                                                                          
/*==========================================================================*/
/*                             Dsm501LowTimeGet()                           */
/*                                                                          */
/*==========================================================================*/
/*Author    : ZHUHUA                                                        */
/*Project   :                                                               */
/*Access    : public                                                        */
/*Created   : 2015-06-10                                                    */
/*--------------------------------------------------------------------------*/
/*Input     : ----                                                          */
/*Output    : ----                                                          */
/*Changed   : ----                                                          */
/*--------------------------------------------------------------------------*/
/*Description :  called in  Dsm501ValueGet(void)                  */
/*                   ##  »ñÈ¡30ÃëÄÚµÍµçÆœµÄÊ±Œä                                                     */
/*                                                                          */
/*==========================================================================*/
void Dsm501LowTimeGet( void )
{
	unsigned long num3;
	unsigned int LowTime = 0;
	unsigned int HighTime = 0;
    for(num3=0;num3<300000;num3++)  //30 s ticking
	{
		if(  digitalRead(DSM501Out1Pin) == 0  )//test every 100us
		{
			LowTime++;
			HighTime = 0;
			DSM501LowTimeIn30s++;
			if(LowTime>1800) //over 180ms is an error
			{
				DSM501ErrorFlag = 1;
				break;
			}
		}
		else
		{
			LowTime = 0;
			HighTime++; 
			if ( HighTime > 10000 ) //cost over  1s
			{
				DSM501ErrorFlag = 1;
				break;
			}
		}
		delayMicroseconds(100);
                
	}                                                                      
//return();
}
/*==========================================================================*/
/*End of Function Dsm501LowTimeGet()                                        */

                                                                          
                                                                          
/*==========================================================================*/
/*                              Dsm501ValueGet()                            */
/*                                                                          */
/*==========================================================================*/
/*Author    : ZHUHUA                                                        */
/*Project   :                                                               */
/*Access    : public                                                        */
/*Created   : 2015-06-10                                                    */
/*--------------------------------------------------------------------------*/
/*Input     : ----                                                          */
/*Output    : ----                                                          */
/*Changed   : ----                                                          */
/*--------------------------------------------------------------------------*/
/*Description : ## ÉÏµçÒ»·ÖÖÓºóÎÈ¶š£¬Õý³£Çé¿ö30s»ñÈ¡Ò»žöÍšµÀµÄÊýŸÝ                                           */
/*     ##Èç¹û²âÁ¿ÆÚŒäµÍµçÆœ³ÖÐøÊ±Œä³¬¹ý90ms£¬·µ»ØŽíÎóÐÅºÅ£¬ÏÂŽÎµ÷ÓÃº¯ÊýºóŽíÎó±êÖŸ×Ô¶¯ÇåÁã          */
/*     ## Ž«žÐÆ÷Ë«ÍšµÀ£¬ÖÃÁã¹Ø±Õ£¬ÖÃÒ»Žò¿ª   channel1¶ÔÓŠDSM501Out1Pin£¬¿Éµ÷£¬                                                                                                                   */
/*==========================================================================*/

TWord Dsm501ValueGet()
{
	DSM501ErrorFlag=0;
    DSM501LowTimeIn30s=0;	
	pinMode(DSM501Out1Pin,INPUT);
	//pinMode(DSM501Out2Pin,INPUT);
	
	Dsm501LowTimeGet(); //cost 30s
	if( DSM501ErrorFlag == 0 ) 
	{
		DSM501LowRatio = DSM501LowTimeIn30s/300 ; //biger 1000
		DustConcentration1 = ( DSM501LowRatio*143/100 + 1 )/10;  //change with the RES on control pin
	}
    //printf("%d.\n",DSM501LowRatio);
	DSM501LowRatio = 0;
	//printf("%f.\n",DustConcentration1);
	DSM501LowTimeIn30s = 0;

        /*if( channel2 == 1 )
	{
		Dsm501LowTimeGet(); //cost 30s
		if( DSM501ErrorFlag == 0 ) 
		{
			DSM501LowRatio = DSM501LowTimeIn30s/300 ; //biger 1000
			DustConcentration2= ( DSM501LowRatio*143/100 + 1 )/10 ; //
		}
		DSM501LowRatio = 0;
		//printf("%f.\n",DustConcentration2);
		DSM501LowTimeIn30s = 0;
	}*/                                                                       
return  DustConcentration1;
}
/*==========================================================================*/
/*End of Function Dsm501ValueGet()                                          */
                                                                          
                                                                          
                                                                          
                                                                          
                                                                          
/*==========================================================================*/
/*End of module DUSTSENSOR.C                                                */













                                                                       
/*==========================================================================*/
/*                                   main()                                 */
/*                                                                          */
/*==========================================================================*/
/*Author    : ZHUHUA                                                        */
/*Project   :                                                               */
/*Access    : public                                                        */
/*Created   : 2015-06-16                                                    */
/*--------------------------------------------------------------------------*/
/*Input     : ----                                                          */
/*Output    : ----                                                          */
/*Changed   : ----                                                          */
/*--------------------------------------------------------------------------*/
/*Description :                                                             */
/*                                                                          */
/*                                                                          */
/*==========================================================================*/
void main( void )
{   
    int x[20];
    double t;
    wiringPiSetup();
	while(1)
	{ 
	      Bh1750ValueGet();
          printf("lightvalue:%d.\n",LightValue);

          Dsm501ValueGet();
	      printf("DS:%d.\n",DustConcentration1);
            
          AM2302ValueGet();
          printf("Humidity:%d.\n",Humidity);
          printf("Temperature:%d.\n",Temperature);
          printf("%x.\n",0x55);             
	}
                                                                          
//return();
}
/*==========================================================================*/
/*End of Function main()                                                    */
                                                                          
                                                                          
                                            
